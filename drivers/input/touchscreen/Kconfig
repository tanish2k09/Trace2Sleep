## drivers/input/touchscreen/Kconfig
```kconfig
#
# Add the following lines in the Kconfig file in the middle somewhere
#

config TOUCHSCREEN_TRACE2WAKE
	tristate "Trace2Wake for touchscreens"
	select TOUCHSCREEN_PREVENT_SLEEP
	default n

config TOUCHSCREEN_PREVENT_SLEEP
	bool "Inihibit sleep on modified touchscreen drivers"
	default n
	help
	  This disables the sleep function of modified touchscreen drivers.
```
